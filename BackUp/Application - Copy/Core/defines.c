/************************************************** Description *******************************************************/
/*
    File : define.c
    Programmer : Mohammad Lotfi
    Used : Refrence and define basical for a microcontroller
    Design Pattern : Nothing
    Types of memory : Nothing
    Total Tread : Nothing
    Site : https://www.mahsen.ir
    Tel : +989124662703
    Email : info@mahsen.ir
    Last Update : 2023/9/3
*/
/************************************************** Warnings **********************************************************/
/*
    Nothing
*/
/************************************************** Wizards ***********************************************************/
/*
    Nothing
*/
/************************************************** Includes **********************************************************/
#include "defines.h"
/************************************************** Defineds **********************************************************/
/*
    Nothing
*/
/************************************************** Names *************************************************************/
/*
    Nothing
*/
/************************************************** Variables *********************************************************/
/*
    Nothing
*/
/************************************************** Opjects ***********************************************************/
/*
    Nothing
*/
/************************************************** Functions *********************************************************/
void DEFINE_Delay_ms(U32 MSecond)
{

}
/*--------------------------------------------------------------------------------------------------------------------*/
void DEFINE_Delay(U32 USecond)
{
  while(USecond--)
  {
        for(U32 i=0; i<(16/6); i++);
  }
}
/*--------------------------------------------------------------------------------------------------------------------*/
U8 DEFINE_Ascii2Hex(U8 Convert)
{
	
      if((Convert >= '0') && (Convert <= '9'))
      {
              return (Convert - '0' + 0x00);
      }
      else if((Convert >= 'a') && (Convert <= 'f'))
      {
              return (Convert - 'a' + 0x0A);			
      }
      else if((Convert >= 'A') && (Convert <= 'F'))
      {
              return (Convert - 'A' + 0x0A);			
      }
      else
      {
              return 0x00;
      }
}
/*--------------------------------------------------------------------------------------------------------------------*/
U8* DEFINE_itoa(U64 Value, U8* Length) //0-4294967295
{   
    static U8 str_b[10+1]; 
    
    if(Value==0)
    {
        *Length = 1;
        return (U8*)"0";
    }
        
    str_b[9] = (Value%10)+'0';
    str_b[8] = ((Value%100)/10)+'0';
    str_b[7] = ((Value%1000)/100)+'0';
    str_b[6] = ((Value%10000)/1000)+'0';
    str_b[5] = ((Value%100000)/10000)+'0';
    str_b[4] = ((Value%1000000)/100000)+'0';
    str_b[3] = ((Value%10000000)/1000000)+'0';
    str_b[2] = ((Value%100000000)/10000000)+'0';
    str_b[1] = ((Value%1000000000)/100000000)+'0';
    str_b[0] = ((Value%10000000000)/1000000000)+'0';
    
    int last=0;
    for(int index=(sizeof(str_b)-1); index>=0; index--)
    {
        if(str_b[index] != '0')
        {
            last = index;
        }
    }
    
    *Length = 10 - last;
    return &str_b[last];
}
/************************************************** Tasks *************************************************************/
/*
    Nothing
*/
/************************************************** Vectors ***********************************************************/
/*
    Nothing
*/
/**********************************************************************************************************************/

